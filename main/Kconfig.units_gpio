## main/Kconfig.units_gpio
```kconfig
menu "Units GPIO"

config APP_UNITS_GPIO_ENABLE
  bool "Enable runtime units override via GPIO"
  default n
  help
    When enabled, a GPIO input can override the display units at runtime
    without reboot. The pin level selects Celsius or Fahrenheit.

config APP_UNITS_GPIO_DEFAULT_PIN
  int "Default units GPIO pin (-1 disables override)"
  range -1 48
  default -1
  help
    Default GPIO used for runtime unit switching. Set to -1 to disable.

config APP_UNITS_GPIO_DEFAULT_PULL
  int "Default units GPIO pull (0=none, 1=up, 2=down)"
  range 0 2
  default 1
  help
    Input pull configuration for the units GPIO.

config APP_UNITS_GPIO_DEFAULT_LEVEL_FOR_C
  bool "GPIO high level selects Celsius"
  default n
  help
    When enabled, a HIGH pin level means Celsius; otherwise LOW selects Celsius.

endmenu
```
